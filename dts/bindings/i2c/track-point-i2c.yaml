## dts/bindings/i2c/track-point-i2c.yaml
```yaml
# Copyright (c) 2019, Intel Corporation
# SPDX-License-Identifier: Apache-2.0

description: I2C Trackpoint

compatible: "zmk,input-track-point-i2c"

include: base.yaml

properties:
  int-gpios:
    type: phandle-array
    required: true
    description: GPIO to which the INT pin is connected.
  reg:
    type: array
    required: true
    description: I2C address in 7 bit format.
```

## src/drivers/input/Kconfig
```kconfig
# Copyright (c) 2022 The ZMK Contributors
# SPDX-License-Identifier: MIT

DT_COMPAT_ZMK_INPUT_PS2_MOUSE := zmk,input-mouse-ps2

DT_COMPAT_ZMK_INPUT_I2C_TRACK_POINT := zmk,input-track-point-i2c

config ZMK_INPUT_MOUSE_PS2
	bool
	default $(dt_compat_enabled,$(DT_COMPAT_ZMK_INPUT_PS2_MOUSE))
    depends on (!ZMK_SPLIT || ZMK_SPLIT_ROLE_CENTRAL)
	select ZMK_MOUSE
    select PS2

config ZMK_INPUT_MOUSE_PS2_ENABLE_PS2_RESEND_CALLBACK
	bool "Get notifications from the underluing PS2 protocol driver when the received data is invalid and when a resend is requested from the peripheral. This helps the mouse driver to re-align its command buffer and prevent unexpected clicks and jerky movements. With the ps2-uart driver this option is not really necessary, but is very useful for the ps2-gpio driver where mis-transmissions are frequent."
	default n

if ZMK_INPUT_MOUSE_PS2

config ZMK_INPUT_MOUSE_PS2_ENABLE_UROB_COMPAT
    bool "Makes the driver compatible with urob's zmk fork. His fork has commits that change the default zmk function definitions. This option adopts the code to make it compatible with his changes. Only enable it if you are using his fork or it will fail to compile."
	default n

config ZMK_INPUT_MOUSE_PS2_ENABLE_ERROR_MITIGATION
    bool "Tries to mitigate transmission errors. Only useful when using a PS2 driver that is prone to miscommunication like the GPIO bitbanging driver."
	default n

endif # ZMK_INPUT_MOUSE_PS2
config ZMK_INPUT_TRACK_POINT_I2C
	bool
	default $(dt_compat_enabled,$(DT_COMPAT_ZMK_INPUT_I2C_TRACK_POINT))
    depends on (!ZMK_SPLIT || ZMK_SPLIT_ROLE_CENTRAL)
	select ZMK_MOUSE
	select I2C
if ZMK_INPUT_TRACK_POINT_I2C
	config ZMK_TP_I2C_LOG_LEVEL
		int "I2C trackpoint module log level"
		default 4 if !ZMK_LOGGING_MINIMAL
		default 0 if ZMK_LOGGING_MINIMAL
	config TP_TRIGGER_OWN_THREAD
		bool 
		default y
	
	config TP_THREAD_STACK_SIZE
		int 
		default 1024
	config TP_THREAD_PRIORITY
		int 
		default 2
	
	config TP_TRIGGER_GLOBAL_THREAD
		bool 
		default y if !TP_TRIGGER_OWN_THREAD
		default n if TP_TRIGGER_OWN_THREAD
	config ZMK_SETTINGS_SAVE_DEBOUNCE
		int 
		default  5
endif 
```
