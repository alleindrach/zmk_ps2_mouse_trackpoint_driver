/*
 * Copyright (c) 2020 The ZMK Contributors
 *
 * SPDX-License-Identifier: MIT
 */

/ {
	behaviors {
		mmm: behavior_mouse_mode {
			compatible = "zmk,behavior-mouse-mode";
			#binding-cells = <0>;
		};
	};
};
